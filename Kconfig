## Kconfig
```kconfig
config ZMK_BEHAVIOR_PIR_SWITCH
    bool
    default y
    depends on DT_HAS_ZMK_BEHAVIOR_PIR_SWITCH_ENABLED
    select FLASH
    select FLASH_MAP
    select CRC
    select LED_STRIP

config ZMK_BATTERY_NIMH_VOLTAGE_DIVIDER
    bool
    default y
    depends on DT_HAS_ZMK_BATTERY_NIMH_VOLTAGE_DIVIDER_ENABLED
    select ADC
```

## dts/bindings/behaviors/zmk,behavior-pir-config-macro.yaml
```yaml
description: |
  センサーが反応したときに送るキーの手順を、フラッシュの設定領域から読み込むマクロ。
  設定領域は設定サイト（docs/index.html）で作った .uf2 で書き込む。
  設定領域が空・壊れている場合は default-keys の手順を使う。

compatible: "zmk,behavior-pir-config-macro"

include: zero_param.yaml

properties:
  key-press:
    type: phandle
    required: true
    description: キー送信に使う &kp
  config-partition:
    type: phandle
    required: true
    description: 設定データを置くフラッシュのパーティション
  default-keys:
    type: array
    required: true
    description: 設定がないときに送るキー（&kp に渡す値）
  tap-ms:
    type: int
    default: 30
  wait-ms:
    type: int
    default: 30
  status-led:
    type: phandle
    description: 反応してから次に反応できるようになるまで点ける LED（gpio-leds の子ノード）
  status-led-hold-ms:
    type: int
    default: 2000
    description: センサー出力が LOW に戻ってから LED を消すまでの時間（ミリ秒）
```

## dts/bindings/behaviors/zmk,behavior-pir-switch.yaml
```yaml
description: |
  PIR Switch 本体の動作。&pir <コマンド> で使う（コマンドは dt-bindings/zmk/pir_switch.h）。
  モードごとに送るキーの手順は、フラッシュの設定領域から読み込む。
  設定領域は設定サイト（docs/index.html）で作った .uf2 で書き込む。
  設定領域が空・壊れている場合は modeN-default-keys の手順を使う。

compatible: "zmk,behavior-pir-switch"

include: one_param.yaml

properties:
  key-press:
    type: phandle
    required: true
    description: キー送信に使う &kp
  config-partition:
    type: phandle
    required: true
    description: 設定データを置くフラッシュのパーティション
  mode-leds:
    type: phandles
    required: true
    description: モード1・モード2の LED（gpio-leds の子ノード）
  red-led:
    type: phandle
    required: true
    description: 起動時の電池残量表示に使う赤の LED（gpio-leds の子ノード）
  mode1-default-keys:
    type: array
    required: true
    description: 設定がないときにモード1で送るキー（&kp に渡す値）
  mode2-default-keys:
    type: array
    required: true
    description: 設定がないときにモード2で送るキー（&kp に渡す値）
  tap-ms:
    type: int
    default: 30
  wait-ms:
    type: int
    default: 30
  indicator-hold-ms:
    type: int
    default: 2000
    description: センサー出力が LOW に戻ってから LED を消すまでの時間（ミリ秒）
```

## dts/bindings/sensor/zmk,battery-nimh-voltage-divider.yaml
```yaml
description: |
  ニッケル水素電池（エネループなど）1本の電圧を分圧して測り、残量（%）を返すセンサー。
  ZMK 標準の zmk,battery-voltage-divider と同じ配線で使えるが、残量の計算を
  リチウムイオン用ではなくニッケル水素用の換算表で行う。

compatible: "zmk,battery-nimh-voltage-divider"

include: voltage-divider.yaml
```
